## Kconfig
```kconfig
# Copyright (c) 2025 Ramon Cristopher Calam
# SPDX-License-Identifier: Apache-2.0

rsource "drivers/Kconfig"
```

## drivers/Kconfig
```kconfig
# Pump Controller Driver Configuration
rsource "pump/Kconfig"

# YF-S201C Flow Sensor Driver Configuration
rsource "sensor/yf_s201c/Kconfig"

# Feedback Relay Driver Configuration
rsource "feedback_relay/Kconfig"
```

## drivers/feedback_relay/Kconfig
```kconfig
config FEEDBACK_RELAY
    bool "Feedback relay driver"
    default y
    depends on GPIO
    help
      Enable driver for relay used as auditory feedback (coil clicks).
      Intended for countdown warning during the last 10 seconds of the timer.

config FEEDBACK_RELAY_INIT_PRIORITY
    int "Feedback relay init priority"
    default 80
    depends on FEEDBACK_RELAY
    help
      Initialization priority for the feedback relay driver.
```

## drivers/pump/Kconfig
```kconfig
# Pump Controller Driver Configuration

config PUMP_CONTROLLER
    bool "Aygu Pump Controller Driver"
    default y
    depends on GPIO
    help
      Enable the Aygu pump controller driver with integrated state management
      and safety timers.

config PUMP_CONTROLLER_INIT_PRIORITY
    int "Pump Controller init priority"
    default 40
    depends on PUMP_CONTROLLER
    help
      Init priority for pump controller driver.
```

## drivers/sensor/yf_s201c/Kconfig
```kconfig
config YF_S201C
	bool "YF-S201C Flow Sensor Driver"
	default y
	depends on GPIO
	help
	  Enable support for YF-S201C hall effect flow sensor.
	  Provides GPIO interrupt-based pulse counting with median filtering
	  and flow rate calculation.

if YF_S201C

config YF_S201C_INIT_PRIORITY
	int "Init priority"
	default 90
	help
	  YF-S201C driver initialization priority

endif # YF_S201C
```

## dts/bindings/aygu,pump-controller.yaml
```yaml
description: Aygu Pump Controller Driver

compatible: "aygu,pump-controller"

include: base.yaml

properties:
  relay-gpios:
    type: phandle-array
    required: true
    description: GPIO for pump relay control

  safety-timeout-min:
    type: int
    default: 5
    description: Safety timeout in minutes before automatic pump shutdown
```

## dts/bindings/aygu/aygu,feedback-relay.yaml
```yaml
description: Relay for auditory feedback via coil click
compatible: "aygu,feedback-relay"
include: base.yaml

properties:
  gpios:
    type: phandle-array
    required: true
    description: |
      GPIO connected to feedback relay.
      Active-low wiring: logic high turns relay ON (coil energized, produces click).
```

## dts/bindings/sensor/aygu,yf-s201c.yaml
```yaml
description: |
  YF-S201C Hall Effect Flow Sensor Driver

  This driver supports the YF-S201C water flow sensor with GPIO interrupt-based
  pulse counting, median filtering, and flow rate calculation.

compatible: "aygu,yf-s201c"

include: base.yaml

properties:
  gpios:
    type: phandle-array
    required: true
    description: GPIO pin for sensor input (interrupt on falling edge)

  pulses-per-liter:
    type: int
    default: 450
    description: Number of pulses per liter for flow rate calculation

  min-period-us:
    type: int
    default: 100
    description: Minimum valid period between pulses in microseconds

  buffer-size:
    type: int
    default: 5
    description: Size of the median filtering buffer (must be odd)

  stale-threshold-ms:
    type: int
    default: 200
    description: Maximum age of valid data before considered stale

  consecutive-invalid-threshold:
    type: int
    default: 5
    description: Number of consecutive invalid periods before buffer reset
```

## tests/drivers/feedback_relay/testcase.yaml
```yaml
tests:
  feedback_relay_driver_emulation:
    tags: drivers feedback_relay
    platform_allow: native_sim
    extra_args: "OVERLAY_CONFIG=boards/native_feedback_relay.overlay"
    harness: ztest
```

## tests/drivers/sensor/yf_s201c/testcase.yaml
```yaml
tests:
  drivers.sensor.yf_s201c:
    tags: drivers sensor yf_s201c
    platform_allow: native_sim
    extra_args: "OVERLAY_CONFIG=boards/native_yf_s201c.overlay"
    harness: ztest
```

## tests/fixed_math/testcase.yaml
```yaml
tests:
  fixed.math:
    tags: fixed math
    platform_allow:
      - qemu_x86
      - native_sim
    harness: ztest
```

## tests/logic/test_flow_processor/testcase.yaml
```yaml
tests:
  logic.flow_processor:
    tags: flow processor logic
    platform_allow:
      - native_sim
      - qemu_x86
    harness: ztest
```

## tests/logic/test_timer_state_machine/testcase.yaml
```yaml
tests:
  timer_state_machine_unit_tests:
    tags: timer logic
    platform_allow: native_sim qemu_x86
    harness: ztest
```

## tests/zbus/testcase.yaml
```yaml
tests:
  zbus.contracts:
    tags: zbus contracts
    platform_allow:
      - qemu_x86
      - native_sim
    harness: ztest
```
